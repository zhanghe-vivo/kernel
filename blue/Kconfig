## bsp/qemu-mps3-an547/drivers/Kconfig
```kconfig
menu "Hardware Drivers Config"
config SOC_MPS3_CORTEX_M55
    bool
    select ARCH_ARM_CORTEX_M55
    select RT_USING_COMPONENTS_INIT
    select RT_USING_USER_MAIN
    default y
menu "Onboard Peripheral Drivers"
config BSP_USING_UART0
    bool "Enable UART0"
    default y
config BSP_USING_UART1
    bool "Enable UART1"
    default n
endmenu
endmenu
```

## kconfig/config/Kconfig
```kconfig
mainmenu "Blue Kernel"

source "$KCONFIG_DIR/$BOARD/Kconfig"

config ALIGN_SIZE
    default 8
    int "Alignment size for CPU architecture data access"

config TICK_PER_SECOND
    default 100
    int "Tick frequency, Hz"

config SMP
    default n
    bool "Enable Symmetric multiprocessing"

config CPUS_NR
    default 4 if SMP
    default 1 if !SMP
    int "Number of CPUs"

config THREAD_PRIORITY
    default y 
    depends on THREAD_PRIORITY_256
    bool "use thread stack priority"

choice
    prompt "The async output thread stack priority"
    default THREAD_PRIORITY_256
    help
      Choose between 32 or 256 for the async output thread priority.
    config THREAD_PRIORITY_32
        bool "32"
        help
          Set async thread priority to 32 (lower priority).
    config THREAD_PRIORITY_256
        bool "256"
        help
          Set async thread priority to 256 (higher priority).
endchoice

config MAIN_THREAD_PRIORITY
    default 100 if THREAD_PRIORITY_256
    default 10 if THREAD_PRIORITY_32
    int "Set main thread priority"

config THREAD_PRIORITY_MAX
    default 256 if THREAD_PRIORITY_256
    default 32 if THREAD_PRIORITY_32
    depends on THREAD_PRIORITY
    int "The async output thread stack priority, Valid values are ONLY 32 or 256."

config SERIAL_RX_FIFO_SIZE
    default 512
    int "The serial rx fifo size"

config SERIAL_TX_FIFO_SIZE
    default 512
    int "The serial tx fifo size"

choice
    prompt "Memory allocation algorithm"
    default ALLOCATOR_TLSF
    config ALLOCATOR_TLSF
        bool "TLSF algorithm"
    config ALLOCATOR_SLAB
        bool "SLAB algorithm"
    config ALLOCATOR_LLFF
        bool "LLFF algorithm"
    config ALLOCATOR_BUDDY
        bool "BUDDY mode"
endchoice

config ALLOCATOR
    string
    default "tlsf" if ALLOCATOR_TLSF
    default "slab" if ALLOCATOR_SLAB
    default "llff" if ALLOCATOR_LLFF
    default "buddy" if ALLOCATOR_BUDDY

config OVERFLOW_CHECK
    default y
    bool "Using stack overflow checking"

config IDLE_HOOK
    default y
    bool "Enable system hook"

config HEAP
    default y
    bool "Using heap"

config HEAP_ISR
    default y
    bool "Using heap in ISR"

config DEBUGGING_INIT
    default y
    bool "Enable debugging of components initialization"

config EVENT
    default y
    bool "Enable event flag"

config MESSAGEQUEUE
    default y
    bool "Enable message queue"

config MAILBOX
    default y
    bool "Enable mailbox"

config MUTEX
    default y
    bool "Enable mutex"

config SEMAPHORE
    default y
    bool "Enable semaphore"

config RWLOCK
    default y
    bool "Enable rwlock"

config CONDVAR
    default y
    bool "Enable condvar"

config COMPAT_NEWLIBC
    default y
    bool "Enable newlibc"

config SCHEDULE_WITH_TIME_SLICE
    default y
    bool "Enable schedule with time_slice"

config STACK_HIGHWATER_CHECK
    default y
    bool "Enable stack overflow checking"

config DEBUGGING_OBJECT
    default n
    bool "Enable debugging of object"

config DEBUGGING_SCHEDULER
    default n
    bool "Enable debugging of scheduler"

config DEBUGGING_CONTEXT
    default n
    bool "Enable debugging of context switch"

config MEMPOOL
    default n
    bool "Enable mempool"

config MEMHEAP
    default n
    bool "Enable memheap"

config MAIN_THREAD_STACK_SIZE
    default 12288
    int "Set main thread stack size"

config IDLE_THREAD_STACK_SIZE
    default 2048
    int "The stack size of idle thread"

config TIMER_THREAD_STACK_SIZE
    default 2048
    int "The stack size of timer thread"

config FDT
    default n
    bool "Enable Flat Device Tree"

config VIRTIO
    default n
    bool "Enable VirtIO"

config PROCFS
    default n
    bool "Enable proc file system"
```

## kconfig/config/qemu_virt64_aarch64/coverage/defconfig
```kconfig
CONFIG_ALIGN_SIZE=8
CONFIG_TICK_PER_SECOND=100
CONFIG_MAIN_THREAD_PRIORITY=100
# CONFIG_SMP is not set
CONFIG_CPUS_NR=1
CONFIG_THREAD_PRIORITY=y
CONFIG_THREAD_PRIORITY_MAX=256
CONFIG_SERIAL_RX_FIFO_SIZE=512
CONFIG_SERIAL_TX_FIFO_SIZE=512
CONFIG_ALLOCATOR_TLSF=y
# CONFIG_ALLOCATOR_SLAB is not set
# CONFIG_ALLOCATOR_LLFF is not set
# CONFIG_ALLOCATOR_BUDDY is not set
CONFIG_ALLOCATOR="tlsf"
CONFIG_OVERFLOW_CHECK=y
CONFIG_IDLE_HOOK=y
CONFIG_HEAP=y
CONFIG_HEAP_ISR=y
CONFIG_DEBUGGING_INIT=y
CONFIG_EVENT=y
CONFIG_MESSAGEQUEUE=y
CONFIG_MAILBOX=y
CONFIG_MUTEX=y
CONFIG_SEMAPHORE=y
CONFIG_RWLOCK=y
CONFIG_CONDVAR=y
CONFIG_COMPAT_NEWLIBC=y
CONFIG_SCHEDULE_WITH_TIME_SLICE=y
CONFIG_STACK_HIGHWATER_CHECK=y
# CONFIG_DEBUGGING_OBJECT is not set
# CONFIG_DEBUGGING_SCHEDULER is not set
# CONFIG_DEBUGGING_CONTEXT is not set
# CONFIG_MEMPOOL is not set
# CONFIG_MEMHEAP is not set
CONFIG_MAIN_THREAD_STACK_SIZE=24576
CONFIG_IDLE_THREAD_STACK_SIZE=4096
CONFIG_TIMER_THREAD_STACK_SIZE=4096
CONFIG_FDT=y
CONFIG_VIRTIO=y
# CONFIG_PROCFS is not set

#
# smoltcp TCP/IP Stack Configuration
#
CONFIG_SMOLTCP=y
CONFIG_ASSEMBLER_MAX_SEGMENT_COUNT=4
CONFIG_REASSEMBLY_BUFFER_COUNT=4
CONFIG_REASSEMBLY_BUFFER_SIZE=1500
CONFIG_FRAGMENTATION_BUFFER_SIZE=4096
CONFIG_IFACE_MAX_ADDR_COUNT=8
CONFIG_IFACE_MAX_MULTICAST_GROUP_COUNT=4
CONFIG_IFACE_MAX_ROUTE_COUNT=2
CONFIG_IFACE_MAX_SIXLOWPAN_ADDRESS_CONTEXT_COUNT=4
CONFIG_IFACE_NEIGHBOR_CACHE_COUNT=8
CONFIG_RPL_RELATIONS_BUFFER_COUNT=16
CONFIG_RPL_PARENTS_BUFFER_COUNT=8
CONFIG_IPV6_HBH_MAX_OPTIONS=4
CONFIG_DNS_MAX_NAME_SIZE=255
CONFIG_DNS_MAX_RESULT_COUNT=1
CONFIG_DNS_MAX_SERVER_COUNT=1
# end of smoltcp TCP/IP Stack Configuration
```

## kconfig/config/qemu_virt64_aarch64/debug/defconfig
```kconfig
CONFIG_ALIGN_SIZE=8
CONFIG_TICK_PER_SECOND=100
CONFIG_MAIN_THREAD_PRIORITY=100
# CONFIG_SMP is not set
CONFIG_CPUS_NR=1
CONFIG_THREAD_PRIORITY=y
CONFIG_THREAD_PRIORITY_MAX=256
CONFIG_SERIAL_RX_FIFO_SIZE=512
CONFIG_SERIAL_TX_FIFO_SIZE=512
CONFIG_ALLOCATOR_TLSF=y
# CONFIG_ALLOCATOR_SLAB is not set
# CONFIG_ALLOCATOR_LLFF is not set
# CONFIG_ALLOCATOR_BUDDY is not set
CONFIG_ALLOCATOR="tlsf"
CONFIG_OVERFLOW_CHECK=y
CONFIG_IDLE_HOOK=y
CONFIG_HEAP=y
CONFIG_HEAP_ISR=y
CONFIG_DEBUGGING_INIT=y
CONFIG_EVENT=y
CONFIG_MESSAGEQUEUE=y
CONFIG_MAILBOX=y
CONFIG_MUTEX=y
CONFIG_SEMAPHORE=y
CONFIG_RWLOCK=y
CONFIG_CONDVAR=y
CONFIG_COMPAT_NEWLIBC=y
CONFIG_SCHEDULE_WITH_TIME_SLICE=y
CONFIG_STACK_HIGHWATER_CHECK=y
# CONFIG_DEBUGGING_OBJECT is not set
# CONFIG_DEBUGGING_SCHEDULER is not set
# CONFIG_DEBUGGING_CONTEXT is not set
# CONFIG_MEMPOOL is not set
# CONFIG_MEMHEAP is not set
CONFIG_MAIN_THREAD_STACK_SIZE=24576
CONFIG_IDLE_THREAD_STACK_SIZE=4096
CONFIG_TIMER_THREAD_STACK_SIZE=4096
CONFIG_FDT=y
CONFIG_VIRTIO=y
```

## rs_src/Kconfig
```kconfig
config USE_RUST
    bool "Use Rust for building"
    default n

config USE_RUST_CLOCK
    bool
    default y
    depends on USE_RUST
```
